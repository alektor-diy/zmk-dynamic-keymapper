## Kconfig
```kconfig
DT_CHOSEN_ZDKM_UART := zdkm,uart

config ZDKM
	bool "Dynamic keymapper"
	default y if $(dt_chosen_enabled,$(DT_CHOSEN_ZDKM_UART))
	depends on !ZMK_SPLIT || ZMK_SPLIT_ROLE_CENTRAL
	depends on $(dt_chosen_enabled,$(DT_CHOSEN_ZDKM_UART))
	select ZMK_USB
	select SETTINGS
	select SERIAL
	select UART_LINE_CTRL
	select CRC
	help
	  Configure combos at runtime over the dedicated USB serial port.
	  Include <zdkm.dtsi> in the keymap to enable this module.

if ZDKM

config ZDKM_COMBO_SLOTS
	int "Number of free combo slots in addition to imported definitions"
	range 1 64
	default 8

config ZDKM_COMBO_TIMEOUT_MS
	int "Default combo timeout in milliseconds"
	range 10 200
	default 50

endif
```

## dts/bindings/behaviors/zdkm,behavior-macro.yaml
```yaml
description: Editable ZDKM macro slot
compatible: "zdkm,behavior-macro"
include: one_param.yaml
```

## dts/bindings/behaviors/zdkm,behavior-unlock.yaml
```yaml
description: Authorize one dynamic keymapper update
compatible: "zdkm,behavior-unlock"
include: zero_param.yaml
```

## dts/bindings/zdkm,combo-action.yaml
```yaml
description: ZMK behavior binding selectable as a dynamic combo action
compatible: "zdkm,combo-action"
properties:
  action-id:
    type: int
    required: true
    description: Unique stable ID between 1 and 255
  display-name:
    type: string
    required: true
  bindings:
    type: phandle-array
    required: true
```
