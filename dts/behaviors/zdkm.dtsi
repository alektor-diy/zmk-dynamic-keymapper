#ifndef ZDKM_BEHAVIORS_DTSI
#define ZDKM_BEHAVIORS_DTSI

/ {
    behaviors {
        zdkm_unlock: zdkm_unlock {
            compatible = "zdkm,behavior-unlock";
            #binding-cells = <0>;
        };

        zdkm_macro: zdkm_macro {
            compatible = "zdkm,behavior-macro";
            #binding-cells = <1>;
            display-name = "ZDKM Macro";
        };
    };
};

#endif
